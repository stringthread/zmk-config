#include "split_38_tb.dtsi"

&default_transform {
  col-offset = <5>;
};

#include "split_38_tb.dtsi"

&kscan_c2r {
  col-gpios
          = <&xiao_d 6>
          , <&xiao_d 3>
          , <&xiao_d 2>
          , <&xiao_d 1>
          , <&xiao_d 0>
          ;
};

&kscan_r2c {
  col-gpios
          = <&xiao_d 6>
          , <&xiao_d 3>
          , <&xiao_d 2>
          , <&xiao_d 1>
          , <&xiao_d 0>
          ;
};
