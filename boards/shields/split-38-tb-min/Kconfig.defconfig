## boards/shields/split-38-tb-min/Kconfig.defconfig
```kconfig
if SHIELD_SPLIT_38_TB_MIN_LEFT

# Name must be less than 16 characters long!
config ZMK_KEYBOARD_NAME
    default "S38+Tb Min"

config ZMK_SPLIT_ROLE_CENTRAL
    default y

endif

if SHIELD_SPLIT_38_TB_MIN_LEFT || SHIELD_SPLIT_38_TB_MIN_RIGHT

config ZMK_SPLIT
    default y

endif
```

## boards/shields/split-38-tb-min/Kconfig.shield
```kconfig
# No whitespace after the comma or in your part name!
config SHIELD_SPLIT_38_TB_MIN_LEFT
    def_bool $(shields_list_contains,split_38_tb_min_left)

# No whitespace after the comma or in your part name!
config SHIELD_SPLIT_38_TB_MIN_RIGHT
    def_bool $(shields_list_contains,split_38_tb_min_right)
```

## config/west.yml
```yaml
manifest:
  remotes:
    - name: zmkfirmware
      url-base: https://github.com/zmkfirmware
    # Additional modules containing boards/shields/custom code can be listed here as well
    # See https://docs.zephyrproject.org/3.2.0/develop/west/manifest.html#projects
    - name: pim447
      url-base: https://github.com/cdc-mkb
  projects:
    - name: zmk
      remote: zmkfirmware
      revision: main
      import: app/west.yml
    - name: pim447
      repo-path: zmk
      remote: pim447
      revision: mouse-pim447
  self:
    path: config
```
